## zy-yocto/woody-build/conf/bblayers.conf
```bitbake
# POKY_BBLAYERS_CONF_VERSION is increased each time build/conf/bblayers.conf
# changes incompatibly
POKY_BBLAYERS_CONF_VERSION = "2"

BBPATH = "${TOPDIR}"
BBFILES ?= ""

BBLAYERS ?= " \
  /home/woody/Desktop/yocto/poky/meta \
  /home/woody/Desktop/yocto/poky/meta-poky \
  /home/woody/Desktop/yocto/poky/meta-yocto-bsp \
  /home/woody/Desktop/yocto/meta-mylayer \
  /home/woody/Desktop/yocto/woody-build/workspace \
  "
#/home/woody/Desktop/yocto/woody-build/workspace 
```
